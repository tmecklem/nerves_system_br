## board/arietta/wifi/at91bootstrap_defconfig
```kconfig
CONFIG_AT91SAM9X5_ARIETTA=y
CONFIG_BUS_SPEED_100MHZ=y
CONFIG_RAM_256MB=y
CONFIG_SDCARD=y
CONFIG_LOAD_LINUX=y
CONFIG_LINUX_ZIMAGE=y
CONFIG_LINUX_KERNEL_ARG_STRING="console=ttyS0,115200 root=/dev/mmcblk0p2 rootfstype=squashfs rootwait"
CONFIG_DEBUG=y
CONFIG_THUMB=y
```

## configs/nerves_arietta_elixir_defconfig
```kconfig
BR2_arm=y
BR2_ARM_INSTRUCTIONS_THUMB=y
BR2_TOOLCHAIN_EXTERNAL=y
BR2_TOOLCHAIN_EXTERNAL_CUSTOM=y
BR2_TOOLCHAIN_EXTERNAL_DOWNLOAD=y
BR2_TOOLCHAIN_EXTERNAL_URL="https://github.com/nerves-project/nerves-toolchain/releases/download/v0.6.1/nerves-arm-unknown-linux-gnueabi-linux-x86_64-v0.6.1.tar.xz"
BR2_TOOLCHAIN_EXTERNAL_CUSTOM_PREFIX="arm-unknown-linux-gnueabi"
BR2_TOOLCHAIN_EXTERNAL_GCC_4_9=y
BR2_TOOLCHAIN_EXTERNAL_HEADERS_3_4=y
BR2_TOOLCHAIN_EXTERNAL_CUSTOM_GLIBC=y
BR2_TOOLCHAIN_EXTERNAL_CXX=y
BR2_ENABLE_LOCALE_PURGE=y
BR2_ENABLE_LOCALE_WHITELIST="locale-archive"
BR2_GENERATE_LOCALE="en_US.UTF-8"
BR2_TARGET_GENERIC_HOSTNAME="nerves"
BR2_TARGET_GENERIC_ISSUE=""
BR2_INIT_NONE=y
# BR2_TARGET_GENERIC_GETTY is not set
# BR2_TARGET_GENERIC_REMOUNT_ROOTFS_RW is not set
BR2_ROOTFS_OVERLAY="../board/nerves-common/rootfs-additions"
BR2_ROOTFS_POST_BUILD_SCRIPT="../board/arietta/post-build.sh"
BR2_ROOTFS_POST_IMAGE_SCRIPT="../board/arietta/post-createfs.sh"
BR2_LINUX_KERNEL=y
BR2_LINUX_KERNEL_CUSTOM_VERSION=y
BR2_LINUX_KERNEL_CUSTOM_VERSION_VALUE="4.0.4"
BR2_LINUX_KERNEL_USE_CUSTOM_CONFIG=y
BR2_LINUX_KERNEL_CUSTOM_CONFIG_FILE="../board/arietta/wifi/linux.config"
BR2_LINUX_KERNEL_ZIMAGE=y
BR2_LINUX_KERNEL_DTS_SUPPORT=y
BR2_LINUX_KERNEL_USE_CUSTOM_DTS=y
BR2_LINUX_KERNEL_CUSTOM_DTS_PATH="../board/arietta/wifi/acme-arietta.dts"
BR2_PACKAGE_LINUX_FIRMWARE=y
BR2_PACKAGE_LINUX_FIRMWARE_RALINK_RT2XX=y
BR2_PACKAGE_OPENSSL=y
BR2_PACKAGE_NCURSES=y
BR2_PACKAGE_IW=y
BR2_PACKAGE_WPA_SUPPLICANT=y
BR2_PACKAGE_WPA_SUPPLICANT_AP_SUPPORT=y
BR2_PACKAGE_WPA_SUPPLICANT_CLI=y
BR2_PACKAGE_WPA_SUPPLICANT_PASSPHRASE=y
BR2_TARGET_ROOTFS_SQUASHFS=y
BR2_TARGET_AT91BOOTSTRAP3=y
BR2_TARGET_AT91BOOTSTRAP3_CUSTOM_GIT=y
BR2_TARGET_AT91BOOTSTRAP3_CUSTOM_REPO_URL="https://github.com/tanzilli/at91bootstrap.git"
BR2_TARGET_AT91BOOTSTRAP3_CUSTOM_REPO_VERSION="cedbde4b36695b715f469f4872f47e5cc8115000"
BR2_TARGET_AT91BOOTSTRAP3_USE_CUSTOM_CONFIG=y
BR2_TARGET_AT91BOOTSTRAP3_CUSTOM_CONFIG_FILE="../board/arietta/wifi/at91bootstrap_defconfig"
BR2_PACKAGE_ERLANG_HISTORY=y
BR2_PACKAGE_FWUP=y
BR2_PACKAGE_NERVES_CONFIG=y
BR2_PACKAGE_NERVES_CONFIG_ELIXIR=y
BR2_PACKAGE_NERVES_CONFIG_EXTRA_MOUNTS="/dev/mmcblk0p3:/root:vfat::"
BR2_PACKAGE_NERVES_CONFIG_HANG_ON_EXIT=y
BR2_PACKAGE_HOST_ERLANG_RELSYNC=y
BR2_PACKAGE_HOST_ERLANG_RELX=y
BR2_PACKAGE_HOST_FWUP=y
```

## package/python-decocare/Config.in
```kconfig
config BR2_PACKAGE_PYTHON_DECOCARE
	bool "python-decocare"
	select BR2_PACKAGE_PYTHON_ARGCOMPLETE # runtime
	select BR2_PACKAGE_PYTHON_DATEUTIL # runtime
	select BR2_PACKAGE_PYTHON_PYSERIAL # runtime
	help
          Audit, inspect, and command MM insulin pumps.

	  https://github.com/openaps/decocare
```

## package/python-mmeowlink/Config.in
```kconfig
config BR2_PACKAGE_PYTHON_MMEOWLINK
	bool "python-mmeowlink"
	select BR2_PACKAGE_PYTHON_ARGCOMPLETE # runtime
	select BR2_PACKAGE_PYTHON_DECOCARE # runtime
	select BR2_PACKAGE_PYTHON_DATEUTIL # runtime
	select BR2_PACKAGE_PYTHON_PYSERIAL # runtime
	help
	  Driver layer for communicating with Medtronic pumps over a variety
	  of radios.

	  https://github.com/oskarpearson/mmeowlink
```
